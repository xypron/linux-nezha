// SPDX-License-Identifier: (GPL-2.0+ OR MIT)
// Copyright (C) 2020 Ondrej Jirman <megous@megous.com>

/dts-v1/;

#include "sun50i-a64-pinephone.dtsi"

#include <dt-bindings/input/gpio-keys.h>
#include <dt-bindings/input/input.h>

/ {
	model = "Pine64 PinePhone Developer Batch (1.0)";
	compatible = "pine64,pinephone-1.0", "allwinner,sun50i-a64";

	gpio-keys {
		compatible = "gpio-keys";

		ring-indicator {
			label = "Ring Indicator";
			gpios = <&pio 1 2 GPIO_ACTIVE_LOW>; /* PB2 */
			linux,code = <KEY_WAKEUP>;
			wakeup-event-action = <EV_ACT_ASSERTED>;
			wakeup-source;
		};
	};
};
